/*
 * Copyright (c) 2022 The ZMK Contributors
 *
 * SPDX-License-Identifier: MIT
 */

#include <dt-bindings/zmk/matrix_transform.h>


/ {

	chosen {
   
		zmk,kscan = &kscan0;
		zmk,matrix_transform = &default_transform;
	};

	default_transform: keymap_transform {
		compatible = "zmk,matrix-transform";
		columns = <14>;
		rows = <1>;
		map = <
			RC(0,0)  RC(0,1)  RC(0,2)    RC(0,4)   RC(0,5)  RC(0,6)  RC(0,7)   RC(0,8)  RC(0,9)    RC(0,10)    RC(0,11)   RC(0,12)   RC(0,13)   RC(0,14)   
		>;
	};

	kscan0: kscan {
		compatible = "zmk,kscan-gpio-direct";
		
		input-gpios =
			<&gpio0 12 (GPIO_ACTIVE_LOW | GPIO_PULL_UP)>,
			<&gpio0 30 (GPIO_ACTIVE_LOW | GPIO_PULL_UP)>,
                        <&gpio0 28 (GPIO_ACTIVE_LOW | GPIO_PULL_UP)>,
			<&gpio0 31 (GPIO_ACTIVE_LOW | GPIO_PULL_UP)>,
			<&gpio0 2 (GPIO_ACTIVE_LOW | GPIO_PULL_UP)>,
                        <&gpio0 3 (GPIO_ACTIVE_LOW | GPIO_PULL_UP)>,
                        <&gpio0 13 (GPIO_ACTIVE_LOW | GPIO_PULL_UP)>,
	<&gpio0 20 (GPIO_ACTIVE_LOW | GPIO_PULL_UP)>,
			<&gpio1 2 (GPIO_ACTIVE_LOW | GPIO_PULL_UP)>,
<&gpio0 21 (GPIO_ACTIVE_LOW | GPIO_PULL_UP)>,
			<&gpio0 22 (GPIO_ACTIVE_LOW | GPIO_PULL_UP)>,
			<&gpio0 17 (GPIO_ACTIVE_LOW | GPIO_PULL_UP)>,
			<&gpio1 0 (GPIO_ACTIVE_LOW | GPIO_PULL_UP)>,
<&gpio0 11 (GPIO_ACTIVE_LOW | GPIO_PULL_UP)>


		;
	

};





}; 



